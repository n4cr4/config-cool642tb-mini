## config/boards/shields/Test/Kconfig.shield
```kconfig
config SHIELD_COOL642TB_MINI_R
    def_bool $(shields_list_contains,cool642tb-mini_R)

config SHIELD_COOL642TB_MINI_L
    def_bool $(shields_list_contains,cool642tb-mini_L)
```

## config/boards/shields/cool642tb-mini/Kconfig.defconfig
```kconfig
if SHIELD_COOL642TB_MINI_R

config ZMK_KEYBOARD_NAME
    default "cool642tb-mini_R"

config ZMK_SPLIT
    default y

config ZMK_SPLIT_ROLE_CENTRAL
    default y

endif

if SHIELD_COOL642TB_MINI_L

config ZMK_KEYBOARD_NAME
    default "cool642tb-mini_L"

config ZMK_SPLIT
    default y

endif
```
